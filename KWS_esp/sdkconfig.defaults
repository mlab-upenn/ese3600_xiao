## KWS_esp/sdkconfig.defaults
```kconfig
# Put console on the USB Serial/JTAG device (shows up over our USB cable)
CONFIG_ESP_CONSOLE_UART_DEFAULT=n
CONFIG_ESP_CONSOLE_UART=n
CONFIG_ESP_CONSOLE_USB_SERIAL_JTAG=y
CONFIG_ESP_CONSOLE_USB_SERIAL_JTAG_ENABLED=y

# Usual console speed (what monitor uses)
CONFIG_ESP_CONSOLE_UART_BAUDRATE=115200
```

## magicwand/sdkconfig.defaults
```kconfig
# ESP32-S3 Configuration
CONFIG_IDF_TARGET="esp32s3"

# Enable PSRAM support
CONFIG_ESP32S3_SPIRAM_SUPPORT=y
CONFIG_SPIRAM_MODE_OCT=y
CONFIG_SPIRAM=y
CONFIG_SPIRAM_SPEED_80M=y
CONFIG_SPIRAM_USE_MALLOC=y

# FreeRTOS configuration
CONFIG_FREERTOS_HZ=1000

# Main task stack size (increase for TensorFlow Lite)
CONFIG_ESP_MAIN_TASK_STACK_SIZE=8192

# Component config
CONFIG_ESP_SYSTEM_EVENT_TASK_STACK_SIZE=4096

# Partition table
CONFIG_PARTITION_TABLE_CUSTOM=n
CONFIG_PARTITION_TABLE_SINGLE_APP_LARGE=y

# USB Serial/JTAG configuration
CONFIG_ESP_CONSOLE_USB_SERIAL_JTAG=y

# Log output
CONFIG_LOG_DEFAULT_LEVEL_INFO=y

# Compiler options
CONFIG_COMPILER_OPTIMIZATION_SIZE=y
```
